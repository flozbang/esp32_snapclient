## components/ai-thinker-audio-kit/Kconfig.projbuild
```kconfig
menu "AI-Thinker ESP32 Audio Kit"

config AI_THINKER_AUDIO_KIT_CUSTOM_BOARD
    bool "AI-Thinker ESP32 Audio Kit with ES8388"
    default y if AUDIO_BOARD_CUSTOM
    help
        Custom ESP-ADF board implementation for the AI-Thinker ESP32 Audio Kit
        using the ES8388 codec. The pin configuration is based on the currently
        working modified LyraT v4.3 board configuration.

endmenu
```

## components/audio_board/Kconfig.projbuild
```kconfig
menu "Custom Audio Board"

choice CUSTOM_AUDIO_BOARD
    prompt "Audio hardware"
    default CUSTOM_AUDIO_BOARD_AI_THINKER_A1S

config CUSTOM_AUDIO_BOARD_AI_THINKER_A1S
    bool "AI-Thinker ESP32 Audio Kit (ES8388)"

endchoice

endmenu
```
